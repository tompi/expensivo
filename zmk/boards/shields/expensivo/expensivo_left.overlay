// Generated by scripts/gen_zmk.py -- edit the generator, not this file.
#include "expensivo.dtsi"

&kscan0 {
    input-gpios
            = <&gpio0 22 (GPIO_ACTIVE_LOW | GPIO_PULL_UP)> // K13
            , <&gpio0 20 (GPIO_ACTIVE_LOW | GPIO_PULL_UP)> // K10
            , <&gpio0 17 (GPIO_ACTIVE_LOW | GPIO_PULL_UP)> // K7
            , <&gpio0 8 (GPIO_ACTIVE_LOW | GPIO_PULL_UP)> // K4
            , <&gpio0 6 (GPIO_ACTIVE_LOW | GPIO_PULL_UP)> // K1
            , <&gpio1 6 (GPIO_ACTIVE_LOW | GPIO_PULL_UP)> // K14
            , <&gpio1 4 (GPIO_ACTIVE_LOW | GPIO_PULL_UP)> // K11
            , <&gpio0 11 (GPIO_ACTIVE_LOW | GPIO_PULL_UP)> // K8
            , <&gpio1 0 (GPIO_ACTIVE_LOW | GPIO_PULL_UP)> // K5
            , <&gpio0 24 (GPIO_ACTIVE_LOW | GPIO_PULL_UP)> // K2
            , <&gpio1 13 (GPIO_ACTIVE_LOW | GPIO_PULL_UP)> // K15
            , <&gpio1 15 (GPIO_ACTIVE_LOW | GPIO_PULL_UP)> // K12
            , <&gpio0 2 (GPIO_ACTIVE_LOW | GPIO_PULL_UP)> // K9
            , <&gpio0 29 (GPIO_ACTIVE_LOW | GPIO_PULL_UP)> // K6
            , <&gpio0 31 (GPIO_ACTIVE_LOW | GPIO_PULL_UP)> // K3
            , <&gpio1 11 (GPIO_ACTIVE_LOW | GPIO_PULL_UP)> // K18
            , <&gpio0 10 (GPIO_ACTIVE_LOW | GPIO_PULL_UP)> // K17
            , <&gpio0 9 (GPIO_ACTIVE_LOW | GPIO_PULL_UP)> // K16
            ;
};

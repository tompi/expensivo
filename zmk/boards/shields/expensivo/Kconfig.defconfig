## zmk/boards/shields/expensivo/Kconfig.defconfig
```kconfig
if SHIELD_EXPENSIVO_LEFT

config ZMK_KEYBOARD_NAME
    default "Expensivo"

config ZMK_SPLIT_ROLE_CENTRAL
    default y

endif

if SHIELD_EXPENSIVO_LEFT || SHIELD_EXPENSIVO_RIGHT

config ZMK_SPLIT
    default y

endif
```

## zmk/boards/shields/expensivo/Kconfig.shield
```kconfig
config SHIELD_EXPENSIVO_LEFT
    def_bool $(shields_list_contains,expensivo_left)

config SHIELD_EXPENSIVO_RIGHT
    def_bool $(shields_list_contains,expensivo_right)
```
